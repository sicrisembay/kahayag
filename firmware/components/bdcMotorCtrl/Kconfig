## firmware/components/bdcMotorCtrl/Kconfig
```kconfig
menu "Motor Configuration"

  choice MOTOR_PINNED_TO_CORE_CHOICE
    prompt "The cpu core which Motor run"
    depends on !FREERTOS_UNICORE
    help
      Specify the cpu core to run motor.
    config MOTOR_PINNED_TO_CORE_0
      bool "Core 0 (PRO CPU)"
    config MOTOR_PINNED_TO_CORE_1
      bool "Core 1 (APP CPU)"
    config MOTOR_NO_CORE_AFFINITY
      bool "No Affinity (PRO or APP CPU)"
    depends on !FREERTOS_UNICORE
  endchoice #MOTOR_PINNED_TO_CORE_CHOICE
  
  choice MOTOR_PWM_FREQ_CHOICE
    prompt "PWM Frequency"
    help
      Specify the supported PWM frequency
    config MOTOR_PWM_FREQ_20KHZ
      bool "20kHz"
    config MOTOR_PWM_FREQ_40KHZ
      bool "40kHz"
    config MOTOR_PWM_FREQ_80KHZ
      bool "80kHz"
  endchoice #MOTOR_PWM_FREQ_CHOICE
  
  config MOTOR_STACK_SIZE
    int "Stack Size of Motor Task"
    default 4096
    help
      Stack Size of Motor Task

  config MOTOR_SPEED_CTRL_INTERVAL
    int "Speed Control Loop Interval, ms"
    default 5
    help
      Speed control calculation interval

  config MOTOR_POSITION_CTRL_INTERVAL
    int "Position Control Loop Interval, ms"
    default 10
    help
      Position control calculation interval

  menu "Motor One"
    choice DRV1_MODE
      prompt "Type of BD62220 operating mode"
      help
        Specify BD62220 mode type
      config DRV1_EXT_PWM
        bool "External PWM Control"
      config DRV1_CONST_CURRENT
        bool "PWM Constant Current Control"
    endchoice #DRV1_MODE
    config DRV1_INA_IO_PIN
      int "INA IO Pin"
      default 26
      help
        IO Pin connected to Rohm INA pin
    config DRV1_INB_IO_PIN
      int "INB IO Pin"
      default 25
      help
        IO Pin connected to Rohm INB pin
    config DRV1_VREF_IO
      int "VREF IO Pin"
      default 12
      help
        IO Pin connected to Rohm Vref pin
    config ENC1_CHA_IO_PIN
      int "Encoder ChA IO Pin"
      default 34
      help
        IO Pin connected to ChA of Encoder
    config ENC1_CHB_IO_PIN
      int "Encoder ChB IO Pin"
      default 35
      help
        IO Pin connected to ChB of Encoder
    config MOT1_STOP_TOL
      int "Motor Position Stop Criteria in radian (Q16 format)"
      default 41177
      help
        For 5-pole pair motor, default is (2*pi)/(2 * N pole pairs) << 16
  endmenu # "Motor One"
  
  menu "Motor Two"
    choice DRV2_MODE
      prompt "Type of BD62220 operating mode"
      help
        Specify BD62220 mode type
      config DRV2_EXT_PWM
        bool "External PWM Control"
      config DRV2_CONST_CURRENT
        bool "PWM Constant Current Control"
    endchoice #DRV2_MODE
    config DRV2_INA_IO_PIN
      int "INA IO Pin"
      default 33
      help
        IO Pin connected to Rohm INA pin
    config DRV2_INB_IO_PIN
      int "INB IO Pin"
      default 32
      help
        IO Pin connected to Rohm INB pin
    config DRV2_VREF_IO
      int "VREF IO Pin"
      default 27
      help
        IO Pin connected to Rohm Vref pin
    config ENC2_CHA_IO_PIN
      int "Encoder ChA IO Pin"
      default 39
      help
        IO Pin connected to ChA of Encoder
    config ENC2_CHB_IO_PIN
      int "Encoder ChB IO Pin"
      default 36
      help
        IO Pin connected to ChB of Encoder
    config MOT2_STOP_TOL
      int "Motor Position Stop Criteria in radian (Q16 format)"
      default 41177
      help
        For 5-pole pair motor, default is (2*pi)/(2 * N pole pairs) << 16
  endmenu # "Motor Two"

  menu "Motor Three"
    choice DRV3_MODE
      prompt "Type of BD62220 operating mode"
      help
        Specify BD62220 mode type
      config DRV3_EXT_PWM
        bool "External PWM Control"
      config DRV3_CONST_CURRENT
        bool "PWM Constant Current Control"
    endchoice #DRV3_MODE
    config DRV3_INA_IO_PIN
      int "INA IO Pin"
      default 16
      help
        IO Pin connected to Rohm INA pin
    config DRV3_INB_IO_PIN
      int "INB IO Pin"
      default 5
      help
        IO Pin connected to Rohm INB pin
    config DRV3_VREF_IO
      int "VREF IO Pin"
      default 19
      help
        IO Pin connected to Rohm Vref pin
    config ENC3_CHA_IO_PIN
      int "Encoder ChA IO Pin"
      default 22
      help
        IO Pin connected to ChA of Encoder
    config ENC3_CHB_IO_PIN
      int "Encoder ChB IO Pin"
      default 23
      help
        IO Pin connected to ChB of Encoder
    config MOT3_STOP_TOL
      int "Motor Position Stop Criteria in radian (Q16 format)"
      default 41177
      help
        For 5-pole pair motor, default is (2*pi)/(2 * N pole pairs) << 16
  endmenu # "Motor Three"

  menu "Motor Four"
    choice DRV4_MODE
      prompt "Type of BD62220 operating mode"
      help
        Specify BD62220 mode type
      config DRV4_EXT_PWM
        bool "External PWM Control"
      config DRV4_CONST_CURRENT
        bool "PWM Constant Current Control"
    endchoice #DRV4_MODE
    config DRV4_INA_IO_PIN
      int "INA IO Pin"
      default 4
      help
        IO Pin connected to Rohm INA pin
    config DRV4_INB_IO_PIN
      int "INB IO Pin"
      default 18
      help
        IO Pin connected to Rohm INB pin
    config DRV4_VREF_IO
      int "VREF IO Pin"
      default 2
      help
        IO Pin connected to Rohm Vref pin
    config ENC4_CHA_IO_PIN
      int "Encoder ChA IO Pin"
      default 17
      help
        IO Pin connected to ChA of Encoder
    config ENC4_CHB_IO_PIN
      int "Encoder ChB IO Pin"
      default 21
      help
        IO Pin connected to ChB of Encoder
    config MOT4_STOP_TOL
      int "Motor Position Stop Criteria in radian (Q16 format)"
      default 41177
      help
        For 5-pole pair motor, default is (2*pi)/(2 * N pole pairs) << 16
  endmenu # "Motor Four"
  
endmenu #Motor Configuration
```

## firmware/components/invensense_motion_driver/Kconfig
```kconfig
menu "Invensense Motion Driver"
  choice INVENSENSE_PINNED_TO_CORE_CHOICE
    prompt "The cpu core which Invensense eMD run"
    depends on !FREERTOS_UNICORE
    help
      Specify the cpu core to run Invensense eMD.
    config INVENSENSE_PINNED_TO_CORE_0
      bool "Core 0 (PRO CPU)"
    config INVENSENSE_PINNED_TO_CORE_1
        bool "Core 1 (APP CPU)"
    config INVENSENSE_NO_CORE_AFFINITY
      bool "No Affinity (PRO or APP CPU)"
  endchoice #INVENSENSE_PINNED_TO_CORE_CHOICE
  
endmenu # Invensense Motion Driver
```

## firmware/motorCtrl/main/Kconfig
```kconfig
menu "User Application"
  choice APP_PINNED_TO_CORE_CHOICE
    prompt "The cpu core which User Application run"
    depends on !FREERTOS_UNICORE
    help
      Specify the cpu core to run User Application.
    config USER_APP_PINNED_TO_CORE_0
      bool "Core 0 (PRO CPU)"
    config USER_APP_PINNED_TO_CORE_1
        bool "Core 1 (APP CPU)"
    config USER_APP_NO_CORE_AFFINITY
      bool "No Affinity (PRO or APP CPU)"
  endchoice #APP_PINNED_TO_CORE_CHOICE

  menu "QSpy Configuration"
    choice QPC_QSPY_PHY_TRANSPORT_CHOICE
      prompt "Physical Transport used by QSpy"
      help
        Specify the physical transport that QSpy uses
      config QPC_QSPY_PHY_UART
        bool "UART"
      config QPC_QSPY_PHY_BT_SPP
        bool "Bluetooth SPP"
    endchoice # QPC_QSPY_PHY_TRANSPORT_CHOICE

    config QPC_QSPY_TX_PIN
      int "QSpy Transmit IO pin"
      depends on QPC_QSPY_PHY_UART
      default 18
      help
        IO pin used for QSpy transmit
    config QPC_QSPY_RX_PIN
      int "QSpy Receive IO pin"
      depends on QPC_QSPY_PHY_UART
      default 19
      help
        IO pin used for QSpy receive
    config QPC_QSPY_TX_SIZE
      int "QSpy Tx Buffer size"
      range 128 2048
      default 512
      help
        Transmit buffer size used by QSpy
    config QPC_QSPY_RX_SIZE
      int "QSpy Rx Buffer size"
      range 128 2048
      default 256
      help
        Receive buffer size used by QSpy
    config QPC_QSPY_STACK_SIZE
      int "QSpy Task Stack Size in bytes"
      default 2048
      help
        Stack size of QSpy task
  endmenu #QSpy Configuration

  config USER_CMD_DEBUG_ENABLED
    bool "Enable debug of User Command"
    default n

  menu "Data Streamer"
    config DATA_STREAMER_STACK_SIZE
      int "Stack Size of Data Streamer Task"
      default 2048
    config DATA_STREAMER_INTERVAL
      int "Time Interval of sending Data"
      default 100
      
  endmenu # "Data Streamer"
  
  menu "MPU9250"
    config MPU9250_I2C_PORT_NUM
      int "I2C Master port used for MPU9250 Communication"
      range 0 1
      default 0
    config MPU9250_I2C_SDA_IO
      int "I2C SDA IO for MPU9250"
      default 13
    config MPU9250_I2C_SCL_IO
      int "I2C SCL IO for MPU9250"
      default 15
    config MPU9250_I2C_CLK_FREQ
      int "I2C Clock Frequency for MPU9250"
      default 100000
    config MPU9250_INT_IO
      int "MPU9250 Interrupt IO"
      default 14
  endmenu # MPU9250
  
endmenu # User Application
```
